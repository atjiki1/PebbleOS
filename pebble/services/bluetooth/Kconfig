## pebble/services/bluetooth/Kconfig
```kconfig
# SPDX-FileCopyrightText: 2026 Core Devices LLC
# SPDX-License-Identifier: Apache-2.0

config SERVICE_BLUETOOTH
    bool "Bluetooth"
    help
      Core Bluetooth service (pairing, bonding, local id, ...).

config BLE_GATT_NOTIF_WRITE_TIMEOUT_MS
    int "GATT notification handoff timeout (ms)"
    default 5 if SOC_SF32LB52
    default 100
    help
      Max time the BT host task blocks for the client to drain the per-client
      GATT subscription buffer before dropping a notification. Must stay below
      the HCI transport's tolerance for a stalled host.

config BLE_GATT_SUBSCRIPTION_DEPTH
    int "GATT subscription buffer depth (notifications)"
    default 8 if SOC_SF32LB52
    default 4
    help
      Per-client GATT subscription buffer depth, in max-size notifications.
      Deeper absorbs notification bursts (fewer drops) at the cost of RAM.

config BT_MULTI_LINK_EXPERIMENT
    bool "Experimental: accept a second BLE link"
    default n
    depends on !RECOVERY_FW
    help
      Experiment for multi-device support. Raises the NimBLE link limit to 2,
      keeps advertising while Settings > Bluetooth is open even with a paired
      phone, and vibrates (double pulse) when a second device connects, short
      pulse when it disconnects. The second link is never paired and gets no
      ANCS/AMS/PPoGATT: it only shows whether the controller accepts it.

config BT_ANCS_CLIENT
    bool "ANCS (Apple Notification Center Service) client"
    default y if !RECOVERY_FW
    help
      Build the ANCS GATT client (iOS notifications). Off in the recovery
      firmware, which has no notification UI.

config SERVICE_BLE_HRM
    bool "Heart rate sharing over BLE"
    default y
    depends on HRM && BT_HRM_SERVICE && !RECOVERY_FW
    help
      Share heart rate measurements with paired devices through the GATT
      Heart Rate Service, with the sharing permission popups and settings.

config BT_AMS_CLIENT
    bool "AMS (Apple Media Service) client"
    default y if !RECOVERY_FW
    help
      Build the AMS GATT client (iOS music control). Off in the recovery
      firmware, which has no music UI.

if SERVICE_BLUETOOTH

module = SERVICE_BLUETOOTH
module-str = Bluetooth
source "subsys/logging/Kconfig.template.log_level"

endif
```
